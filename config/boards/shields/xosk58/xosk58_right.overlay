#include "xosk58.dtsi" // Notice that the main dtsi files are included in the overlay.

&default_transform { // The matrix transform for this board is 6 columns over because the left half is 6 columns wide according to the matrix.
    col-offset = <6>;
};

&kscan0 {
    col-gpios
        = <&nrf52840dk_nrf52840 102 GPIO_ACTIVE_HIGH> // col0 in the schematic
        , <&nrf52840dk_nrf52840 104 GPIO_ACTIVE_HIGH> // col1 in the schematic
        , <&nrf52840dk_nrf52840 106 GPIO_ACTIVE_HIGH> // col2 in the schematic
        , <&nrf52840dk_nrf52840 009 GPIO_ACTIVE_HIGH> // col3 in the schematic
        , <&nrf52840dk_nrf52840 010 GPIO_ACTIVE_HIGH> // col4 in the schematic
        , <&nrf52840dk_nrf52840 031 GPIO_ACTIVE_HIGH> // col5 in the schematic
        ;
};