// #include "nordic/nrf52840_qiaa.dtsi" // Notice that the main dtsi files are included in the overlay.
#include "xosk58.dtsi"
&kscan0 {
    col-gpios
        = <&pro_micro 4   GPIO_ACTIVE_HIGH> // col0 in the schematic
        , <&pro_micro 8  GPIO_ACTIVE_HIGH> // col1 in the schematic
        , <&pro_micro 9  GPIO_ACTIVE_HIGH> // col2 in the schematic
        , <&pro_micro 10 GPIO_ACTIVE_HIGH> // col3 in the schematic
        , <&pro_micro 16 GPIO_ACTIVE_HIGH> // col4 in the schematic
        , <&pro_micro 21 GPIO_ACTIVE_HIGH> // col5 in the schematic
        ;
};