## boards/arm/nice_nano/Kconfig.board
```kconfig
# nice!nano board configuration

# Copyright (c) 2020 Pete Johanson
# SPDX-License-Identifier: MIT

config BOARD_NICE_NANO
    bool "nice!nano"
    depends on SOC_NRF52840_QIAA

config BOARD_NICE_NANO_V2
    bool "nice!nano v2"
    depends on SOC_NRF52840_QIAA


config BOARD_NICE_NANO_V3
    bool "nice!nano v3"
    depends on SOC_NRF52840_QIAA
```

## config/boards/shields/xosk58/Kconfig.defconfig
```kconfig
if SHIELD_XOSK58_LEFT

config ZMK_KEYBOARD_NAME
    default "xosk58"

config ZMK_SPLIT_ROLE_CENTRAL
    default y

endif


if SHIELD_XOSK58_LEFT || SHIELD_XOSK58_RIGHT

config ZMK_SPLIT
    default y

config ZMK_BLE
    default y
    
endif
```

## config/boards/shields/xosk58/Kconfig.shield
```kconfig
config SHIELD_XOSK58_LEFT
    def_bool $(shields_list_contains, xosk58_left)

config SHIELD_XOSK58_RIGHT
    def_bool $(shields_list_contains, xosk58_right)
```
